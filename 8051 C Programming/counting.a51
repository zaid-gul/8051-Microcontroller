ORG 00H
START:
CALL LCD_INITIALIZE
SETB P3.4
CALL COUNTER
JMP START

COUNTER:
MOV TMOD,#06
MOV TH0,#00
MOV TL0,#00
AGAIN:
SETB TR0
BACK:
MOV A,TL0
CALL CONVERT
CALL DISPLAY
JNB TF0,BACK
CLR TF0
CLR TR0
JMP AGAIN
RET 
LCD_INITIALIZE:
MOV A,#38H   
ACALL CMD
MOV A,#0EH   
ACALL CMD
MOV A,#01H   
ACALL CMD
MOV A,#06H   
ACALL CMD
MOV A,#0EH    
ACALL CMD
RET
DISPLAY:
MOV A ,#82H   
CALL CMD
MOV A,R4
CALL DT
CALL DELAY
MOV A ,#83H
CALL CMD
MOV A,R2
CALL DT
CALL DELAY
MOV A ,#84H
CALL CMD
MOV A,R3
CALL DT
CALL DELAY
RET
CMD:
MOV P1,A
CLR P2.0
CLR P2.1
SETB P2.2
ACALL DELAY
CLR P2.2
RET
CONVERT:
MOV B,#10
DIV AB
MOV R2,B
MOV B,#10
DIV AB
ORL A,#30H
MOV R4,A
MOV A,B
ORL A,#30H
MOV R3,A
MOV A,R2
MOV A,#30H
MOV R2,A
RET
DT:
MOV P1,A
SETB P2.0
CLR P2.1
SETB P2.2
ACALL DELAY
CLR P2.2
RET
DELAY:  MOV R6,#250D
        MOV R7,#250D
LABEL1: DJNZ R6,LABEL1
LABEL2: DJNZ R7,LABEL2
RET      
END
